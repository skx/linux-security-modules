## security/can-exec/Kconfig
```kconfig
config SECURITY_CAN-EXEC
	bool "can-exec Security Module"
	depends on SECURITY
	depends on NET
	select SECURITYFS
	select SECURITY_PATH
	select SECURITY_NETWORK
	select SRCU
	select BUILD_BIN2C
	default n
	help
	  This selects an access control module which invokes userspace.
          Binaries will only be permitted if /sbin/can-exec returns 0.
```

## security/hashcheck/Kconfig
```kconfig
config SECURITY_HASH_CHECK
	bool "Hash-Checking Security Module"
	depends on SECURITY
	depends on NET
	select SECURITYFS
	select SECURITY_PATH
	select SECURITY_NETWORK
	select SRCU
	select BUILD_BIN2C
	default n
	help
	  This selects an attr-based access control.
          Binaries will only be permitted to be executed
          if there is a corresponding hash digest stored
          in the extended attribute.
```
